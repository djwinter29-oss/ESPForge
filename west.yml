## west.yml
```yaml
manifest:
  version: "1.2"
  projects:
    - name: zephyr
      url: https://github.com/zephyrproject-rtos/zephyr
      revision: v4.3.2
      import:
        name-allowlist:
          - hal_espressif
          - fatfs
          - mbedtls
  self:
    path: espforge
```
